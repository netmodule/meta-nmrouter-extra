## conf/layer.conf
```bitbake
# We have a conf and classes directory, add to BBPATH
BBPATH .= ":${LAYERDIR}"

# We have recipes-* directories, add to BBFILES
BBFILES += "${LAYERDIR}/recipes-*/*/*.bb ${LAYERDIR}/recipes-*/*/*.bbappend"

BBFILE_COLLECTIONS += "nmrouter-ext"
BBFILE_PATTERN_nmrouter-ext = "^${LAYERDIR}/"
BBFILE_PRIORITY_nmrouter-ext = "10"

# This should only be incremented on significant changes that will
# cause compatibility issues with other layers
LAYERVERSION_nmrouter-ext = "1"

LAYERDEPENDS_nmrouter-ext = "core"
```
